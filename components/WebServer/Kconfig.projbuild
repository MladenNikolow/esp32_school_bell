## components/WebServer/Kconfig.projbuild
```kconfig
menu "WebServer Auth"

    config WS_AUTH_USERNAME
        string "Service account username"
        default "admin"
        help
            Username for the service (administrator) account.
            This is a compile-time constant and cannot be changed at runtime.

    config WS_AUTH_PASSWORD
        string "Service account initial password"
        default "password123"
        help
            Initial password for the service account. Used only on first boot
            to generate a salted SHA-256 hash stored in NVS. After first boot
            this value is ignored — the NVS hash is the source of truth.
            Change this before deploying to production.

endmenu
```

## main/Kconfig.projbuild
```kconfig
menu "School Bell Configuration"

    config BSP_IO_EXPANDER_I2C_ADDR
        hex "CH32V003 IO Expander I2C address"
        default 0x20
        help
            I2C address of the CH32V003 IO expander on the Waveshare
            ESP32-S3-Touch-LCD-4 board. The default 0x20 matches the
            address used by the board. The upstream component default
            is 0x24.

endmenu
```
